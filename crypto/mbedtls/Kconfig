## graphics/lvgl/Kconfig
```kconfig
#
# For a description of the syntax of this configuration file,
# see the file kconfig-language.txt in the NuttX tools repository.
#

menuconfig GRAPHICS_LVGL
	bool "Light and Versatile Graphic Library (LVGL)"
	default n
	---help---
		Enable support for the LVGL GUI library.

if GRAPHICS_LVGL

config LVGL_VERSION
	string "LVGL Version"
	default "8.0.0"

source "$APPSDIR/graphics/lvgl/lvgl/Kconfig"

config LV_USE_LCDDEV_INTERFACE
	bool "LCD device interface"
	default n

if LV_USE_LCDDEV_INTERFACE

config LV_LCDDEV_INTERFACE_DEFAULT_DEVICEPATH
	string "LCD default device path"
	default "/dev/lcd0"

config LV_USE_FULL_SCREEN_BUFFER
	bool "Use full screen buffer"
	default n

if !LV_USE_FULL_SCREEN_BUFFER

config LV_DEFAULT_LINE_BUFFER
	int "Default buffer size (in line)"
	default 10

endif # LV_USE_FULL_SCREEN_BUFFER

config LV_USE_DOUBLE_BUFFER
	bool "Use double buffer"
	default n

endif # LV_USE_LCDDEV_INTERFACE

menuconfig LV_USE_FBDEV_INTERFACE
	bool "Framebuffer device interface"
	default n

if LV_USE_FBDEV_INTERFACE

config LV_FBDEV_INTERFACE_DEFAULT_DEVICEPATH
	string "Framebuffer default device path"
	default "/dev/fb0"

config LV_FBDEV_USE_DOUBLE_BUFFER
	bool "Use direct mode in double framebuffer"
	default n

config LV_FBDEV_USE_STATIC_BUFFER
	bool "Use separate static draw buffer"
	default n
	depends on !LV_FBDEV_USE_DOUBLE_BUFFER

if LV_FBDEV_USE_STATIC_BUFFER

config LV_FBDEV_HOR_RES
	int "Horizontal resolution"
	default 480

config LV_FBDEV_VER_RES
	int "Vertical resolution"
	default 480

config LV_FBDEV_USE_CUSTOM_SECTION
	bool "Use custom section"
	default n

if LV_FBDEV_USE_CUSTOM_SECTION

config LV_FBDEV_SECTION_NAME
	string "Section name"
	default ""

endif # LV_FBDEV_USE_CUSTOM_SECTION

endif # LV_FBDEV_USE_STATIC_BUFFER

endif # LV_USE_FBDEV_INTERFACE

config LV_USE_GPU_INTERFACE
	bool "Use GPU acceleration"
	default n

if LV_USE_GPU_INTERFACE

config LV_GPU_USE_LOG
	bool "Output GPU warnings and errors"
	default n
	depends on LV_USE_LOG

config LV_GPU_USE_PERF
	bool "Enable GPU performance measurement outputs"
	default n

config LV_GPU_DRAW_LINE
	bool "Use GPU accelerated draw_line"
	default n

config LV_GPU_DRAW_ARC
	bool "Use GPU accelerated draw_arc"
	default y

config LV_GPU_DRAW_POLYGON
	bool "Use GPU accelerated draw_polygon"
	default y

config LV_GPU_DRAW_RECT
	bool "Use GPU accelerated draw_rect"
	default y

config LV_GPU_DRAW_IMG
	bool "Use GPU accelerated draw_img"
	default y

choice
	prompt "Default power mode"
	default GPU_MODE_PERFORMANCE

config GPU_MODE_POWERSAVE
	bool "Low power mode"

config GPU_MODE_BALANCED
	bool "Balanced mode"

config GPU_MODE_PERFORMANCE
	bool "High performance mode"

endchoice

endif

menuconfig LV_USE_BUTTON_INTERFACE
	bool "Button input interface"
	default n

if LV_USE_BUTTON_INTERFACE

config LV_BUTTON_INTERFACE_DEFAULT_DEVICEPATH
	string "Button default device path"
	default "/dev/buttons"

config LV_BUTTON_INTERFACE_BUTTON_0_MAP_X
	int "Button 0 mapping coordinate x"
	default 0

config LV_BUTTON_INTERFACE_BUTTON_0_MAP_Y
	int "Button 0 mapping coordinate y"
	default 0

config LV_BUTTON_INTERFACE_BUTTON_1_MAP_X
	int "Button 1 mapping coordinate x"
	default 0

config LV_BUTTON_INTERFACE_BUTTON_1_MAP_Y
	int "Button 1 mapping coordinate y"
	default 0

config LV_BUTTON_INTERFACE_BUTTON_2_MAP_X
	int "Button 2 mapping coordinate x"
	default 0

config LV_BUTTON_INTERFACE_BUTTON_2_MAP_Y
	int "Button 2 mapping coordinate y"
	default 0

config LV_BUTTON_INTERFACE_BUTTON_3_MAP_X
	int "Button 3 mapping coordinate x"
	default 0

config LV_BUTTON_INTERFACE_BUTTON_3_MAP_Y
	int "Button 3 mapping coordinate y"
	default 0

config LV_BUTTON_INTERFACE_BUTTON_4_MAP_X
	int "Button 4 mapping coordinate x"
	default 0

config LV_BUTTON_INTERFACE_BUTTON_4_MAP_Y
	int "Button 4 mapping coordinate y"
	default 0

config LV_BUTTON_INTERFACE_BUTTON_5_MAP_X
	int "Button 5 mapping coordinate x"
	default 0

config LV_BUTTON_INTERFACE_BUTTON_5_MAP_Y
	int "Button 5 mapping coordinate y"
	default 0

endif # LV_USE_BUTTON_INTERFACE

menuconfig LV_USE_KEYPAD_INTERFACE
	bool "Keypad input interface"
	default n
	---help---
	button bit map < 0 is no binding, must >= 0 and < 31 to binding button device.

if LV_USE_KEYPAD_INTERFACE

config LV_KEYPAD_INTERFACE_DEFAULT_DEVICEPATH
	string "Button default device path"
	default "/dev/buttons"

config LV_KEYPAD_INTERFACE_KEY_UP_MAP_BIT
	int "LV_KEY_UP button bit map"
	default -1

config LV_KEYPAD_INTERFACE_KEY_DOWN_MAP_BIT
	int "LV_KEY_DOWN button bit map"
	default -1

config LV_KEYPAD_INTERFACE_KEY_RIGHT_MAP_BIT
	int "LV_KEY_RIGHT button bit map"
	default -1

config LV_KEYPAD_INTERFACE_KEY_LEFT_MAP_BIT
	int "LV_KEY_LEFT button bit map"
	default -1

config LV_KEYPAD_INTERFACE_KEY_ESC_MAP_BIT
	int "LV_KEY_ESC button bit map"
	default -1

config LV_KEYPAD_INTERFACE_KEY_DEL_MAP_BIT
	int "LV_KEY_DEL button bit map"
	default -1

config LV_KEYPAD_INTERFACE_KEY_BACKSPACE_MAP_BIT
	int "LV_KEY_BACKSPACE button bit map"
	default -1

config LV_KEYPAD_INTERFACE_KEY_ENTER_MAP_BIT
	int "LV_KEY_ENTER button bit map"
	default -1

config LV_KEYPAD_INTERFACE_KEY_NEXT_MAP_BIT
	int "LV_KEY_NEXT button bit map"
	default -1

config LV_KEYPAD_INTERFACE_KEY_PREV_MAP_BIT
	int "LV_KEY_PREV button bit map"
	default -1

config LV_KEYPAD_INTERFACE_KEY_HOME_MAP_BIT
	int "LV_KEY_HOME button bit map"
	default -1

config LV_KEYPAD_INTERFACE_KEY_END_MAP_BIT
	int "LV_KEY_END button bit map"
	default -1

endif # LV_USE_KEYPAD_INTERFACE

config LV_USE_TOUCHPAD_INTERFACE
	bool "Touchpad input interface"
	default n

if LV_USE_TOUCHPAD_INTERFACE

config LV_TOUCHPAD_INTERFACE_DEFAULT_DEVICEPATH
	string "Touchpad default device path"
	default "/dev/input0"

endif # LV_USE_TOUCHPAD_INTERFACE

config LV_USE_ENCODER_INTERFACE
	depends on INPUT_MOUSE_WHEEL
	bool "Encoder input interface"
	default n

if LV_USE_ENCODER_INTERFACE

config LV_ENCODER_INTERFACE_DEFAULT_DEVICEPATH
	string "Encoder default device path"
	default "/dev/input0"

endif # LV_USE_ENCODER_INTERFACE

menu "Image Decoder"

config LV_USE_DECODER_JPEG_TURBO
	bool "Enable JPEG decoder"
	default n

config LV_USE_DECODER_LODEPNG
	bool "Enable PNG decoder"
	default n

endmenu

menu "LVGL extension"

config LVGL_EXTENSION
	bool "Enable LVGL extension"
	default n
	---help---
		Enable LVGL extension

if LVGL_EXTENSION

menu "font manager config"

config LVX_USE_FONT_MANAGER
	bool "LVX_USE_FONT_MANAGER"
	default y
	depends on LV_USE_FREETYPE
	---help---
		Enable font-manager for freetype fonts.

config FONT_LIB_PATH
	string "The path of the font library"
	depends on LVX_USE_FONT_MANAGER
	default "/data/"
	help
		The path of the font library. eg:
		/data/	, /data/font/xxxxx
		Note: '/' is required at the end of the string.

endmenu

config LVX_USE_WIDGETS
	bool "Enable widgets extension"
	default y
	---help---
		Enable widgets extension

if LVX_USE_WIDGETS

config	LVX_USE_THEME_EXTENDED
	bool "LVX_USE_THEME_EXTENDED"
	default y
	---help---
		Enable use theme extended

config LVX_USE_BTN
	bool "LVX_USE_BTN"
	default y
	---help---
		Enable use lvx_btn widgets

config LVX_USE_RADIO
	bool "LVX_USE_RADIO"
	default y
	---help---
		Enable use lvx_radio widgets

config LVX_USE_SWITCH
	bool "LVX_USE_SWITCH"
	default y
	---help---
		Enable use lvx_switch widgets

config LVX_USE_PICKER
	bool "LVX_USE_PICKER"
	default y
	---help---
		Enable use lvx_picker widgets

config LVX_USE_MSGBOX
	bool "LVX_USE_MSGBOX"
	default y
	---help---
		Enable use lvx_msgbox widgets

config LVX_USE_ARC_SCROLLBAR
	bool "LVX_USE_ARC_SCROLLBAR"
	default y
	---help---
		Enable use lvx_arc_scrollbar widgets

config LVX_USE_CHART
	bool "LVX_USE_CHART"
	default y
	---help---
		Enable use lvx_chart widgets

config LVX_USE_RLE
	bool "RLE binary file compression support"
	default y
	---help---
		Enalbe decoder to file .rle. When enabled, rle file decoder is
		registered to lvgl.

config LVX_USE_BIN_DECODER
	bool "Custom binary file decoder that load full bin to RAM"
	default n
	---help---
		Enalbe decoder to file .bin. Unlike the lvgl default bin decoder, this
		one read all file data to buffer.

endif

endif

endmenu

config LV_ATTRIBUTE_FAST_MEM_CUSTOM_SECTION_NAME
	string "LV_ATTRIBUTE_FAST_MEM Section Name"
	default ""
	---help---
		Set this option to configure custom memory as LV_ATTRIBUTE_FAST_MEM

endif # GRAPHICS_LVGL
```

## system/dmalloc/Kconfig
```kconfig
#
# For a description of the syntax of this configuration file,
# see the file kconfig-language.txt in the NuttX tools repository.
#

config SYSTEM_DMALLOC
	tristate "dmalloc"
	default n
	depends on MM_DMALLOC
	---help---
		Enable dmalloc utility program

if SYSTEM_DMALLOC

config SYSTEM_DMALLOC_PRIORITY
	int "dmalloc thread priority"
	default 100

config SYSTEM_DMALLOC_STACKSIZE
	int "dmalloc stack size"
	default DEFAULT_TASK_STACKSIZE

config SYSTEM_DMALLOC_PROGNAME
	string "Program name"
	default "dmalloc"
	---help---
		This is the name of the program that will be used
		when the dmalloc ELF program is installed.

endif
```

## system/libuv/Kconfig
```kconfig
#
# For a description of the syntax of this configuration file,
# see the file kconfig-language.txt in the NuttX tools repository.
#

config LIBUV
	bool "libuv asynchronous I/O Library"
	default n
	select CLOCK_MONOTONIC
	select PIPES
	---help---
		Enable build for libuv asynchronous I/O Library

if LIBUV

config LIBUV_THREADPOOL_SIZE
	int "libuv default thread pool size"
	default 1

menu "libuv extension"

config LIBUV_EXTENSION
	bool "Enable libuv extension"
	default n
	---help---
		Enable libuv extension

if LIBUV_EXTENSION

config LIBUV_EXTENSION_TEST
	bool "libuv extension test"
	default n
	---help---
		Enable libuv extension test

if LIBUV_EXTENSION_TEST

config LIBUV_EXTENSION_TEST_PRIORITY
	int "libuv extension test priority"
	default 100

config LIBUV_EXTENSION_TEST_TASK_STACKSIZE
	int "libuv extension test stack size"
	default 65535

endif

endif

endmenu

endif
```

## testing/ltp/Kconfig
```kconfig
#
# For a description of the syntax of this configuration file,
# see the file kconfig-language.txt in the NuttX tools repository.
#

config TESTING_LTP
	tristate "linux test project"
	default n
	---help---
		Enable support for the Linux Test Project(LTP) framework
```

## testing/riltest/Kconfig
```kconfig
#
# For a description of the syntax of this configuration file,
# see the file kconfig-language.txt in the NuttX tools repository.
#

config TESTING_RIL_TEST
	tristate "RIL tesing tool kit"
	default n
	---help---
		Enable ril tesing tool kit

if TESTING_RIL_TEST

config TESTING_RIL_TEST_PROGNAME
	string "Program name"
	default "ril_test_tool"
	---help---
		This is the name of the program that will be used when the NSH ELF
		program is installed.

config TESTING_RIL_TEST_PRIORITY
	int "ril_test_tool test task priority"
	default 100

config TESTING_RIL_TEST_STACKSIZE
	int "ril_test_tool test stack size"
	default  DEFAULT_TASK_STACKSIZE

config RIL_TEST_CONFIGS_PATH
	string "RIL test configuration directory"
	default ""
	---help---
		This is the directory of the RIL test configuration JSON file
		(aka ril_req.json). Note that the path should be the absolute path.

config RIL_TESTCASES_OUT
	string "RIL testcases output directory"
	default ""
	---help---
		This is the directory where the ril testcases to be generated.
		Note that the path should be the absolute path.

config LIBRIL_HEADER_PATH
	string "Location of the RILD headers"
	default ""
	---help---
		This is the location of where the RIL headers we should use. Basically,
		we just need ril.h for building the tool. Note that the path should be
		a absolute path to the RIL headers.

config RIL_DOMAIN_SOCKET_PATH
	string "Location of the domain socket to connect to RIL"
	default "./rild"
	---help---
		This is the filesystem path of the communication socket between RIL
		and the testing tool

endif

config TESTING_RILD_STUB
	tristate "RILD tesing stub"
	default n
	---help---
		Enable ril tesing stub

if TESTING_RILD_STUB

config TESTING_RILD_PROGNAME
	string "Program name"
	default "rild_stub"
	---help---
		This is the name of the program that will be used when the NSH ELF
		program is installed.

config TESTING_RILD_PRIORITY
	int "rild_stub test task priority"
	default 100

config TESTING_RILD_STACKSIZE
	int "rild_stub test stack size"
	default  DEFAULT_TASK_STACKSIZE

endif
```
