## crypto/mbedtls/Kconfig
```kconfig
#
# For a description of the syntax of this configuration file,
# see the file kconfig-language.txt in the NuttX tools repository.
#

menuconfig CRYPTO_MBEDTLS
	bool "Mbed TLS Cryptography Library"
	default n
	select DEV_URANDOM
	---help---
		Enable support for Mbed TLS.

if CRYPTO_MBEDTLS

config MBEDTLS_VERSION
	string "Mbed TLS Version"
	default "3.0.0"

config MBEDTLS_DEBUG_C
	bool "This module provides debugging functions."
	default n
	help
		This module provides debugging functions.

config MBEDTLS_SSL_MAX_CONTENT_LEN
	int "Maximum length (in bytes) of incoming and outgoing plaintext fragments."
	default 16384
	help
		Maximum length (in bytes) of incoming and outgoing plaintext fragments.

config MBEDTLS_SSL_SRV_C
	bool "This module is required for SSL/TLS server support."
	default n
	help
		This module is required for SSL/TLS server support.

config MBEDTLS_PLATFORM_MEMORY
	bool "Enable the memory allocation layer."
	default n
	help

config MBEDTLS_ENTROPY_HARDWARE_ALT
	bool "Uncomment this macro to let mbed TLS use your own implementation of a hardware entropy collector."
	default n
	help

config MBEDTLS_AES_ROM_TABLES
	bool "Store the AES tables in ROM."
	default n
	help

config MBEDTLS_REMOVE_ARC4_CIPHERSUITES
	bool "Remove RC4 ciphersuites by default in SSL / TLS."
	default y
	help

config MBEDTLS_NO_PLATFORM_ENTROPY
	bool "Do not use built-in platform entropy functions."
	default n
	help

config MBEDTLS_SELF_TEST
	bool "Enable the checkup functions (*_self_test)."
	default n
	help

config MBEDTLS_SSL_DTLS_CLIENT_PORT_REUSE
	bool "Enable server-side support for clients that reconnect from the same port."
	default y
	help

config MBEDTLS_BLOWFISH_C
	bool "Enable the Blowfish block cipher."
	default y
	help

config MBEDTLS_CAMELLIA_C
	bool "Enable the Camellia block cipher."
	default y
	help

config MBEDTLS_CERTS_C
	bool "Enable the test certificates."
	default y
	help

config MBEDTLS_PADLOCK_C
	bool "Enable VIA Padlock support on x86."
	default y
	help

config MBEDTLS_TIMING_C
	bool "Enable the semi-portable timing interface."
	default y
	help

config MBEDTLS_SSL_KEEP_PEER_CERTIFICATE
	bool "Enable the availability of the API mbedtls_ssl_get_peer_cert() giving access to the peer's certificate after completion of the handshake."
	default y
	help

config MBEDTLS_SSL_PROTO_DTLS
	bool "Enable support for DTLS (all available versions)."
	default y
	help

if MBEDTLS_SSL_PROTO_DTLS

config MBEDTLS_SSL_DTLS_ANTI_REPLAY
	bool "Enable support for the anti-replay mechanism in DTLS."
	default y
	help

config MBEDTLS_SSL_DTLS_HELLO_VERIFY
	bool "Enable support for HelloVerifyRequest on DTLS servers."
	default y
	help

config MBEDTLS_SSL_DTLS_BADMAC_LIMIT
	bool "Enable support for a limit of records with bad MAC."
	default y
	help

endif

config MBEDTLS_SSL_ALPN
	bool "Enable support for RFC 7301 Application Layer Protocol Negotiation."
	default y
	help

config MBEDTLS_AESNI_C
	bool "Enable AES-NI support on x86-64."
	default y
	help

config MBEDTLS_ECP_WINDOW_SIZE
	int "Maximum window size used"
	default 6
	help

config MBEDTLS_ECP_FIXED_POINT_OPTIM
	bool "Enable fixed-point speed-up"
	default y
	help

config MBEDTLS_CMAC_C
	bool "Enable the CMAC (Cipher-based Message Authentication Code) mode for block"
	default n
	help

menuconfig MBEDTLS_APPS
	tristate "Mbed TLS Applications"
	default n
	---help---
		Enable Mbed TLS Applications

if MBEDTLS_APPS

config MBEDTLS_DEFAULT_TASK_STACKSIZE
	int "Mbed TLS app default stack size"
	default 8192

config MBEDTLS_APP_BENCHMARK
	bool "Mbed TLS benchmark"
	default n
	---help---
		Enable the Mbed TLS self test

if MBEDTLS_APP_BENCHMARK

config MBEDTLS_APP_BENCHMARK_PROGNAME
	string "Program name"
	default "mbedbenchmark"
	---help---
		This is the name of the program that will be used when the NSH ELF
		program is installed.

config MBEDTLS_APP_BENCHMARK_PRIORITY
	int "Benchmark task priority"
	default 100

config MBEDTLS_APP_BENCHMARK_STACKSIZE
	int "Benchmark stack size"
	default MBEDTLS_DEFAULT_TASK_STACKSIZE
endif

config MBEDTLS_APP_SELFTEST
	bool "Mbed TLS Self Test"
	default n
	---help---
		Enable the Mbed TLS self test

if MBEDTLS_APP_SELFTEST

config MBEDTLS_APP_SELFTEST_PROGNAME
	string "Program name"
	default "mbedselftest"
	---help---
		This is the name of the program that will be used when the NSH ELF
		program is installed.

config MBEDTLS_APP_SELFTEST_PRIORITY
	int "Self test task priority"
	default 100

config MBEDTLS_APP_SELFTEST_STACKSIZE
	int "Self test stack size"
	default MBEDTLS_DEFAULT_TASK_STACKSIZE
endif

endif

endif # CRYPTO_MBEDTLS
```

## examples/bandx/Kconfig
```kconfig
#
# For a description of the syntax of this configuration file,
# see the file kconfig-language.txt in the NuttX tools repository.
#

config EXAMPLES_BANDX
	tristate "BandX example"
	default n
	---help---
		Enable the BandX example

if EXAMPLES_BANDX

config EXAMPLES_BANDX_CALIBRATE
	bool "Calibrate touchscreen"
	default y
	---help---
		Calibrate touchscreen before demo start, but some touchscreen
		don't need it, like capacitive touchscreen.

config EXAMPLES_BANDX_BUFF_SIZE
	int "Display buffer size (in line)"
	default 20

endif
```

## examples/dma2d/Kconfig
```kconfig
#
# For a description of the syntax of this configuration file,
# see the file kconfig-language.txt in the NuttX tools repository.
#

config EXAMPLES_DMA2D_TEST
	tristate "DMA2D Test example"
	default n
	---help---
		Enable the \"Test based on DMA2D!\" example

if EXAMPLES_DMA2D_TEST

config EXAMPLES_DMA2D_TEST_PROGNAME
	string "Program name"
	default "dma2d"
	---help---
		This is the name of the program that will be used when the NSH ELF
		program is installed.

config EXAMPLES_DMA2D_TEST_PRIORITY
	int "DMA2D Test task priority"
	default 100

config EXAMPLES_DMA2D_TEST_STACKSIZE
	int "DMA2D Test stack size"
	default DEFAULT_TASK_STACKSIZE

endif
```

## examples/lvgldemo/Kconfig
```kconfig
#
# For a description of the syntax of this configuration file,
# see the file kconfig-language.txt in the NuttX tools repository.
#

menuconfig EXAMPLES_LVGLDEMO
	tristate "LVGL Demo"
	default n
	depends on GRAPHICS_LVGL
	---help---
		Enable build the Light and Versatile Graphics Library Demo programs

if EXAMPLES_LVGLDEMO

config EXAMPLES_LVGLDEMO_PRIORITY
	int "lvgldemo task priority"
	default 100

config EXAMPLES_LVGLDEMO_STACKSIZE
	int "lvgldemo stack size"
	default 32768

comment "Input configuration options"
	depends on INPUT_TOUCHSCREEN || INPUT_MOUSE

config EXAMPLES_LVGLDEMO_CALIBRATE
	bool "Calibrate touchscreen"
	default y
	depends on INPUT_TOUCHSCREEN || INPUT_MOUSE
	---help---
		Calibrate touchscreen before demo start, but some touchscreen
		don't need it, like capacitive touchscreen.

if INPUT_TOUCHSCREEN

config EXAMPLES_LVGLDEMO_MINOR
	int "Touchscreen minor device number"
	default 0
	---help---
		The minor device number.  Minor=N corresponds to touchscreen device
		/dev/inputN.  Note this value must with EXAMPLES_LVGLDEMO_DEVPATH.
		Default 0.

config EXAMPLES_LVGLDEMO_DEVPATH
	string "Touchscreen device path"
	default "/dev/input0"
	---help---
		The path to the touchscreen device.  This must be consistent with
		EXAMPLES_LVGLDEMO_MINOR. Default: "/dev/input0"

endif # INPUT_TOUCHSCREEN

config EXAMPLES_LVGLDEMO_MOUSE
	bool "Mouse interface"
	default n
	depends on INPUT_MOUSE
	---help---
		The LittleVGL demo can also be configured to work with a mouse
		driver by setting this option.

endif # EXAMPLES_LVGLDEMO
```

## examples/watchx/Kconfig
```kconfig
#
# For a description of the syntax of this configuration file,
# see the file kconfig-language.txt in the NuttX tools repository.
#

config EXAMPLES_WATCHX
	tristate "WatchX example"
	default n
	---help---
		Enable the WatchX example

if EXAMPLES_WATCHX

config EXAMPLES_WATCHX_CALIBRATE
	bool "Calibrate touchscreen"
	default y
	---help---
		Calibrate touchscreen before demo start, but some touchscreen
		don't need it, like capacitive touchscreen.

config EXAMPLES_WATCHX_BUFF_SIZE
	int "Display buffer size (in line)"
	default 20

endif
```

## gpsutils/minmea/Kconfig
```kconfig
#
# For a description of the syntax of this configuration file,
# see the file kconfig-language.txt in the NuttX tools repository.
#

config GPSUTILS_MINMEA_LIB
	bool "MINMEA NMEA Library"
	default n
	---help---
		Enable support for the MINMEA NMEA library.

		NOTE: This library depends on having some version of math.h
		at include/nuttx.  There are some different ways to accomplish
		this.  See the discussion in the top-level nuttx/README.txt file.

if GPSUTILS_MINMEA_LIB

config GPSUTILS_MINMEA_BREAM_LIB
	bool "BREAM NMEA Library"
	default n
	---help---
		Enable support for the BREAM private nmea library.
		NOTE: This library depends on gps gpsutils/minmea

endif
```
